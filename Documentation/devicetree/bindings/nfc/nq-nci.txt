## Documentation/devicetree/bindings/nfc/nq-nci.txt
```
Qualcomm Technologies, Inc NQxxxx NFC NCI device

Near Field Communication (NFC) device is based on NFC Controller Interface (NCI)

Required properties:

- compatible: "qcom,nq-nci"
- reg: NCI i2c slave address.
- qcom,nq-ven: specific gpio for hardware reset.
- qcom,nq-irq: specific gpio for read interrupt.
- qcom,nq-firm: gpio for firmware download.
- qcom,nq-clkreq: gpio for clock.
- interrupt-parent: Should be phandle for the interrupt controller
                    that services interrupts for this device.
- interrupts: Nfc read interrupt,gpio-clk-req interrupt


Recommended properties:

- interrupt-names: names of interrupts, should include "nfc_irq", used for reference


Optional properties:

- pinctrl-names, pinctrl-0, pincntrl-1: references to our pincntrl settings
- clocks, clock-names: must contain the NQxxxx's core clock.
- qcom,nq-esepwr: gpio to control power of secure element.

Example:

	nq@28 {
		compatible = "qcom,nq-nci";
		reg = <0x28>;
		qcom,nq-irq = <&msm_gpio 29 0x00>;
		qcom,nq-ven = <&msm_gpio 30 0x00>;
		qcom,nq-firm = <&pm8994_gpios 7 0x00>;
		qcom,nq-clkreq = <&pm8994_gpios 10 0x00>;
		qcom,nq-esepwr = <&pm8994_gpios 12 0x00>;
		qcom,clk-src = "BBCLK2";
		interrupt-parent = <&msm_gpio>;
		interrupts = <29 0>;
		interrupt-names = "nfc_irq";
		pinctrl-names = "nfc_active","nfc_suspend";
		pinctrl-0 = <&nfc_int_active &nfc_disable_active>;
		pinctrl-1 = <&nfc_int_suspend &nfc_disable_suspend>;
		clocks = <&clock_rpm clk_bb_clk2_pin>;
		clock-names = "ref_clk";
	};
```

## arch/arm/hotplug/Kconfig
```kconfig
config CLUSTER_PLUG
        bool "Enable cluster-plug cpu hotplug driver"
        default n
        help
          CPU hotplug driver designed for ARM big.LITTLE systems where
          both the big and little CPUs are of the same type. On these
          systems, it preferable to normall use the big cluster, and
          only activate the little cluster for highly parallel loads.
          This hotplug implementation always keeps the big cluster
          online, and only activates the little cluster for heavy
          parallel loads.
```
